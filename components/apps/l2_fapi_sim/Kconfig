## components/linux-kernel/xlnx-4.0-mod/drivers/vux/Kconfig
```kconfig
menu "VUX Dev Zone"

config VUX
	bool "VUX Dev Zone"
	default y
	help
		VUX Development zone

if VUX

config SFP
	tristate "SFP"
	help
		Driver for SFP+

endif

endmenu
```
